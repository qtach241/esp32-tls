## main/Kconfig.projbuild
```kconfig
# put here your custom config value
menu "Project Configuration"
config ESP_WIFI_SSID
    string "WiFi SSID"
    default "myssid"
    help
	SSID (network name) for the example to connect to.

config ESP_WIFI_PASSWORD
    string "WiFi Password"
    default "mypassword"
    help
	WiFi password (WPA or WPA2) for the example to use.

config FIRMWARE_UPGRADE_URL
    string "firmware upgrade url endpoint"
    default "https://192.168.0.15:8070/app-template.bin"
    help
        URL of server which hosts the firmware
        image.	
endmenu
```
